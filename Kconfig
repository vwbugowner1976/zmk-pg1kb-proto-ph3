## Kconfig
```kconfig
menu "PG1KB runtime features"

config PG1KB_INERTIA_RUNTIME_SETTINGS
    bool "PG1KB scroll inertia runtime settings"
    depends on ZMK_CUSTOM_SETTINGS
    depends on ZMK_INPUT_PROCESSOR_SCROLL_INERTIA
    default n
    help
      Expose PG1KB scroll inertia parameters through cormoran custom settings.
      The settings are applied to the scroll-inertia processor at runtime.

config PG1KB_BLE_MANAGEMENT_STUDIO_RPC
    bool "PG1KB BLE management Studio RPC"
    depends on ZMK_STUDIO_RPC
    depends on ZMK_BLE
    default n
    help
      Expose BLE profile status and profile management commands through a
      secured MyKeebStudio custom Studio RPC subsystem.

endmenu
```

## boards/shields/pg1kb_proto/Kconfig.defconfig
```kconfig
if SHIELD_PG1KB_PROTO_LEFT

config ZMK_KEYBOARD_NAME
    default "PG1KB Proto"

config ZMK_SPLIT_ROLE_CENTRAL
    default n

config INPUT
    bool
    default y

config SPI
    bool
    default y

config ZMK_POINTING
    bool
    default y

endif

if SHIELD_PG1KB_PROTO_RIGHT

config ZMK_KEYBOARD_NAME
    default "PG1KB Proto"

config ZMK_SPLIT_ROLE_CENTRAL
    default y

config INPUT
    bool
    default y

config SPI
    bool
    default y

config ZMK_BLE
    bool
    default y

config ZMK_USB
    bool
    default y

config ZMK_POINTING
    bool
    default y

endif

if SHIELD_PG1KB_PROTO_LEFT || SHIELD_PG1KB_PROTO_RIGHT

config ZMK_SPLIT
    default y

# トラックボールドライバは左右とも PAW3222 / PMW3610 のどちらも選べるようにしておく。
# overlay の compatible に一致した側だけを有効にするため、default に DT 条件を付ける。
# ここで `config PMW3610` を再定義すると、ドライバ側の定義が持つ
# `depends on DT_HAS_PIXART_PMW3610_ENABLED` では抑止できない（Kconfig は複数定義の
# depends を OR で扱うため）。そのため default 側で明示的に条件を付ける必要がある。
config PAW3222
    bool
    default y if DT_HAS_PIXART_PAW3222_ENABLED

config PMW3610
    bool
    default y if DT_HAS_PIXART_PMW3610_ENABLED

endif
```

## config/west.yml
```yaml
manifest:
  remotes:
    - name: zmkfirmware
      url-base: https://github.com/zmkfirmware
    - name: sekigon-gonnoc
      url-base: https://github.com/sekigon-gonnoc
    - name: badjeff
      url-base: https://github.com/badjeff
    - name: mjmjm0101
      url-base: https://github.com/mjmjm0101
    # non-lipo モジュールの ZMK_SLEEP 強制解除を待つ間だけ使う fork。
    # 本家に取り込まれたら sekigon-gonnoc/main に戻すこと。
    - name: snize
      url-base: https://github.com/snize
    - name: vwbugowner1976
      url-base: https://github.com/vwbugowner1976
    - name: cormoran
      url-base: https://github.com/cormoran
    - name: prospector
      url-base: https://github.com/t-ogura
  projects:
    - name: zmk
      remote: cormoran
      revision: v0.3+custom-studio-protocol
      import:
        file: app/west.yml
    - name: zmk-driver-paw3222
      remote: vwbugowner1976
      revision: main
    - name: zmk-pmw3610-driver
      remote: badjeff
      revision: zmk-0.3
    - name: zmk-feature-non-lipo-battery-management
      remote: snize
      revision: fix/do-not-force-zmk-sleep
    - name: zmk-input-processor-scroll-inertia
      remote: mjmjm0101
      revision: f7dadefee453d555fe066d13a3de3bb60739b45e
    # Zephyr 3.5 / ZMK v0.3 compatible fork. Modern custom-settings uses
    # `configdefault`, which this Zephyr generation cannot parse.
    - name: zmk-feature-custom-settings-v03
      remote: vwbugowner1976
      revision: 419ffdc727a0bb09cac0298b74345b878473fbbc
      path: modules/zmk-feature-custom-settings
    - name: zmk-module-runtime-input-processor
      remote: cormoran
      revision: 43618985f8c9d5457cc333b7ca0733f2d361911e
    - name: zmk-feature-runtime-combo
      remote: cormoran
      revision: 2a6a1f412f0127099db1df1e11b656bb0fc8d82e
    - name: prospector-zmk-module
      remote: prospector
      revision: v2.2.1
      path: modules/prospector-zmk-module
    - name: zmk-behavior-jpkeysforuslayout
      remote: vwbugowner1976
      revision: 0f5376a9c52b6b64a1e5f64aff3be61723f14151
  self:
    path: zmk-pg1kb-proto-ph3
```

## runtime-settings/Kconfig
```kconfig
config PG1KB_INERTIA_RUNTIME_SETTINGS
    bool "PG1KB scroll inertia runtime settings"
    default y
    depends on ZMK_CUSTOM_SETTINGS
    depends on ZMK_INPUT_PROCESSOR_SCROLL_INERTIA
    help
      Expose the right-hand Sym scroll-inertia enable/start/move/stop
      parameters through Custom Settings for live tuning in My Keeb Studio.
```

## west.yml
```yaml
manifest:
  remotes:
    - name: sekigon-gonnoc
      url-base: https://github.com/sekigon-gonnoc
    - name: badjeff
      url-base: https://github.com/badjeff
    - name: mjmjm0101
      url-base: https://github.com/mjmjm0101
    # non-lipo モジュールの ZMK_SLEEP 強制解除を待つ間だけ使う fork。
    # 本家に取り込まれたら sekigon-gonnoc/main に戻すこと。
    - name: snize
      url-base: https://github.com/snize
  projects:
    - name: zmk-driver-paw3222
      remote: sekigon-gonnoc
      revision: main
    - name: zmk-pmw3610-driver
      remote: badjeff
      revision: zmk-0.3
    - name: zmk-feature-non-lipo-battery-management
      remote: snize
      revision: fix/do-not-force-zmk-sleep
    - name: zmk-input-processor-scroll-inertia
      remote: mjmjm0101
      revision: main
```
